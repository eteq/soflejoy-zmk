## boards/shields/soflejoy/Kconfig.defconfig
```kconfig
# Copyright (c) 2020 Ryan Cross
# SPDX-License-Identifier: MIT

if SHIELD_SOFLEJOY_LEFT

config ZMK_KEYBOARD_NAME
    default "Soflejoy"

config ZMK_SPLIT_ROLE_CENTRAL
    default y

config EC11
    default y

#config EC11_TRIGGER_GLOBAL_THREAD
#    default y

endif

if SHIELD_SOFLEJOY_LEFT || SHIELD_SOFLEJOY_RIGHT

config ZMK_SPLIT
    default y

config ZMK_POINTING
    default y

config ZMK_DISPLAY
    default y

if ZMK_DISPLAY

config I2C
    default y

config SSD1306
    default y

config ZMK_WIDGET_BATTERY_STATUS_SHOW_PERCENTAGE
    default y


endif # ZMK_DISPLAY

if LVGL

config LV_Z_VDB_SIZE
    default 64

config LV_DPI_DEF
    default 148

config LV_Z_BITS_PER_PIXEL
    default 1

choice LV_COLOR_DEPTH
    default LV_COLOR_DEPTH_1
endchoice

endif # LVGL

config ZMK_RGB_UNDERGLOW
    default y

if ZMK_RGB_UNDERGLOW

config WS2812_STRIP
    default y


config ZMK_RGB_UNDERGLOW_EFF_START
    default 1
config ZMK_RGB_UNDERGLOW_AUTO_OFF_IDLE
    default y
config ZMK_RGB_UNDERGLOW_ON_START
    default n
config ZMK_RGB_UNDERGLOW_AUTO_OFF_USB
    default n
config ZMK_RGB_UNDERGLOW_BRT_START
    default 50

endif

config ZMK_RGB_UNDERGLOW_EXT_POWER
    default n


config ZMK_KSCAN_DEBOUNCE_PRESS_MS
    default 4
config ZMK_KSCAN_DEBOUNCE_RELEASE_MS
    default 4

config ZMK_POINTING
    default y
config ZMK_POINTING_SMOOTH_SCROLLING
    default n

config ZMK_SLEEP
    default y
config ZMK_IDLE_TIMEOUT
    default 15000

config ZMK_PM_SOFT_OFF
    default y

endif
```

## boards/shields/soflejoy/Kconfig.shield
```kconfig
# Copyright (c) 2020 Ryan Cross
# SPDX-License-Identifier: MIT

config SHIELD_SOFLEJOY_LEFT
    def_bool $(shields_list_contains,soflejoy_left)

config SHIELD_SOFLEJOY_RIGHT
    def_bool $(shields_list_contains,soflejoy_right)
```
